## conf/bblayers.conf.sample
```bitbake
# POKY_BBLAYERS_CONF_VERSION is increased each time build/conf/bblayers.conf
# changes incompatibly
POKY_BBLAYERS_CONF_VERSION = "2"

BBPATH = "${TOPDIR}"
BBFILES ?= ""

BBLAYERS ?= " \
  ##OEROOT##/meta \
  ##OEROOT##/meta-poky \
  ##OEROOT##/meta-yocto-bsp \
  ##OEROOT##/../meta-gplv2 \
  ##OEROOT##/../meta-rzg2 \
  ##OEROOT##/../meta-linaro/meta-linaro-toolchain \
  ##OEROOT##/../meta-linaro/meta-optee \
  ##OEROOT##/../meta-openembedded/meta-oe \
  ##OEROOT##/../meta-openembedded/meta-networking \
  ##OEROOT##/../meta-openembedded/meta-filesystems \
  ##OEROOT##/../meta-openembedded/meta-python \
  ##OEROOT##/../meta-openembedded/meta-multimedia \
  ##OEROOT##/../meta-qt5 \
  ##OEROOT##/../meta-beacon-common \
  ##OEROOT##/../meta-beacon-rzg \
  ##OEROOT##/../meta-laird-cp \
  "
```

## conf/layer.conf
```bitbake
# We have a conf and classes directory, add to BBPATH
BBPATH .= ":${LAYERDIR}"

#Remove Renesas provided BT/WiFi packages
IMAGE_INSTALL_remove = "kernel-module-wlcore-sdio"
IMAGE_INSTALL_remove = "bt-fw init-wl18xx"

#Remove bluez ALSA and recommend using pulseaudio instead.
IMAGE_INSTALL_remove = " bluez-alsa"

IMAGE_INSTALL_append = " \
		 lwb-backports-laird \
		 lwb5-fcc-firmware \
		 brcm-patchram-plus \
		 "

# We have recipes-* directories, add to BBFILES
BBFILES += "${LAYERDIR}/recipes-*/*/*.bb \
            ${LAYERDIR}/recipes-*/*/*.bbappend"

BBFILE_COLLECTIONS += "logicpd-rzg"
BBFILE_PATTERN_logicpd-rzg = "^${LAYERDIR}/"
BBFILE_PRIORITY_logicpd-rzg = "6"

LAYERDEPENDS_logicpd-rzg = "rzg2"

PREFERRED_VERSION_openssl = "debian"
BBMASK  += "/meta-laird-cp/recipes-packages/sterling-supplicant"
BBMASK  += "/meta-laird-cp/recipes-packages/summit-supplicant"
BBMASK  += "/meta-laird-cp/recipes-packages/openssl"
```

## wic/beacon-kit.wks
```
# short-description: Create SD card image for a Beacon Embedded kit.
# long-description: Creates a partitioned SD card image for Beacon 
# EmbeddedWorks Renesas RZ/G2 based development kit.
# Boot files are located in the first vfat partition.

part --source bootimg-partition --ondisk mmcblk2 --fstype=vfat --label boot --active --align 1024 --size 100
part / --source rootfs --ondisk mmcblk --fstype=ext4 --label rootfs --align 1024
```
